## boards/inpudiy/PNCATEHO_Welcome_board/Kconfig.PNCATEHO_Welcome_board
```kconfig
# Copyright (c) 2023 The ZMK Contributors
# SPDX-License-Identifier: Apache-2.0

config BOARD_PNCATEHO_Welcome_board
    select ZMK_BOARD_COMPAT
    imply RETAINED_MEM
    imply RETENTION
    imply RETENTION_BOOT_MODE
```

## boards/inpudiy/PNCATEHO_Welcome_board/Kconfig.board
```kconfig
# Copyright (c) 2023 The ZMK Contributors
# SPDX-License-Identifier: Apache-2.0

config BOARD_PNCATEHO_Welcome_board
    bool "PNCATEHO Welcome"
    select ZMK_BOARD_COMPAT
    imply RETAINED_MEM
    imply RETENTION
    imply RETENTION_BOOT_MODE
```

## boards/inpudiy/PNCATEHO_Welcome_board/board.yml
```yaml
board:
  extend: PNCATEHO_Welcome_board
  vendor: inpudiy
  variants:
    - name: zmk
      qualifier: rp2040
```

## boards/shields/PNCATEHO_Welcome-keyboard/Kconfig.shield
```kconfig
# Copyright (c) 2020 The ZMK Contributors
# SPDX-License-Identifier: MIT

config SHIELD_PNCATEHO_Welcome_keyboard
    def_bool $(shields_list_contains,PNCATEHO_Welcome_keyboard)
```

## boards/shields/PNCATEHO_Welcome_keyboard/Kconfig.defconfig
```kconfig
# Copyright (c) 2020 The ZMK Contributors
# SPDX-License-Identifier: MIT

if SHIELD_PNCATEHO_WELCOME_KEYBOARD

config ZMK_KEYBOARD_NAME
    default "PNCATEHO Welcome"

config ZMK_SPLIT
    default n
endif
```

## config/west.yml
```yaml
manifest:
  remotes:
    - name: zmkfirmware
      url-base: https://github.com/zmkfirmware
    - name: inpudiy
      url-base: https://github.com/inpudiy
  projects:
    - name: zmk
      remote: zmkfirmware
      revision: main
      import: app/west.yml
    - name: zmk-PNCATEHO_Welcome-board
      remote: inpudiy
      revision: main
      import: config/west.yml
  self:
    path: config
```
